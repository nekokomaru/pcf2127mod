// Definitions for several I2C based Real Time Clocks
/dts-v1/;
/plugin/;

/ {
	compatible = "brcm,bcm2835";

	fragment@0 {
		target = <&i2cbus>;
		__dormant__ {
			#address-cells = <1>;
			#size-cells = <0>;

			pcf2127_11: pcf2127_11@51 {
				compatible = "nxp,pcf2127_11";
				reg = <0x51>;
			};
		};
	};

	fragment@1 {
		target = <&i2cbus>;
		__dormant__ {
			#address-cells = <1>;
			#size-cells = <0>;

			pcf2129_11: pcf2129_11@51 {
				compatible = "nxp,pcf2129_11";
				reg = <0x51>;
			};
		};
	};

	fragment@2 {
		target = <&i2cbus>;
		__dormant__ {
			#address-cells = <1>;
			#size-cells = <0>;

			pca2129_11: pca2129_11@51 {
				compatible = "nxp,pca2129_11";
				reg = <0x51>;
			};
		};
	};

	frag100: fragment@100 {
		target = <&i2c_arm>;
		i2cbus: __overlay__ {
			status = "okay";
		};
	};

	__overrides__ {
		pcf2127_11 = <0>,"+0";
		pcf2129_11 = <0>,"+1";
		pca2129_11 = <0>,"+2";

		i2c0 = <&frag100>, "target:0=",<&i2c0>;
		i2c_csi_dsi = <&frag100>, "target:0=",<&i2c_csi_dsi>;

		i2c1 = <&frag100>, "target:0=",<&i2c1>;
		i2c3 = <&frag100>, "target:0=",<&i2c3>;
		i2c4 = <&frag100>, "target:0=",<&i2c4>;
		i2c5 = <&frag100>, "target:0=",<&i2c5>;
		i2c6 = <&frag100>, "target:0=",<&i2c6>;

		wakeup-source = <&pcf2127_11>,"wakeup-source?",
				<&pcf2129_11>,"wakeup-source?",
				<&pca2129_11>,"wakeup-source?";

		init-regs = <&pcf2127_11>,"init-regs?",
                            <&pcf2129_11>,"init-regs?",
                            <&pca2129_11>,"init-regs?";

                clear-ints = <&pcf2127_11>,"clear-ints?",
                             <&pcf2129_11>,"clear-ints?",
                             <&pca2129_11>,"clear-ints?";
	};
};
